## Kconfig
```kconfig
# Copyright (c) 2022 Telink Semiconductor
# SPDX-License-Identifier: Apache-2.0

config HAL_TELINK_V1
    bool "Telink HAL V1"
    depends on SOC_RISCV_TELINK_B91 || SOC_RISCV_TELINK_B92
    default y

config HAL_TELINK_V2
    bool "Telink HAL V2"
    depends on SOC_RISCV_TELINK_TL321X || SOC_RISCV_TELINK_TL322X || SOC_RISCV_TELINK_TL323X || SOC_RISCV_TELINK_TL521X || SOC_RISCV_TELINK_TL523X || SOC_RISCV_TELINK_TL721X
    default y

if HAL_TELINK_V1
    rsource "hal_v1/Kconfig"
endif

if HAL_TELINK_V2
    rsource "hal_v2/Kconfig"
endif
```

## hal_v1/tlsr9/crypto/Kconfig
```kconfig
# Copyright (c) 2026 Telink Semiconductor
# SPDX-License-Identifier: Apache-2.0

if TELINK_B9X_MBEDTLS_HW_ACCELERATION || TELINK_B9X_TINYCRYPT_HW_ACCELERATION || \
	TELINK_TLX_MBEDTLS_HW_ACCELERATION || TELINK_TLX_TINYCRYPT_HW_ACCELERATION

choice
	prompt "Telink crypto back-ends log level"
	default TELINK_CRYPTO_BACKEND_LOG_LEVEL_INFO
config TELINK_CRYPTO_BACKEND_LOG_LEVEL_CRIT
	bool "Critical"
config TELINK_CRYPTO_BACKEND_LOG_LEVEL_WARN
	bool "Warning"
config TELINK_CRYPTO_BACKEND_LOG_LEVEL_INFO
	bool "Informational"
config TELINK_CRYPTO_BACKEND_LOG_LEVEL_DEBG
	bool "Debug"
endchoice

config TELINK_CRYPTO_BACKEND_LOG_LEVEL
	int
	default 1 if TELINK_CRYPTO_BACKEND_LOG_LEVEL_CRIT
	default 2 if TELINK_CRYPTO_BACKEND_LOG_LEVEL_WARN
	default 3 if TELINK_CRYPTO_BACKEND_LOG_LEVEL_INFO
	default 4 if TELINK_CRYPTO_BACKEND_LOG_LEVEL_DEBG
	default 0

if TELINK_TLX_MBEDTLS_HW_ACCELERATION || TELINK_TLX_TINYCRYPT_HW_ACCELERATION

config TELINK_TLX_SHA_HW_SLOTS
	int "Telink TLX simultimes HW SHA slots number"
	range 1 64
	default 4

endif

endif
```

## hal_v2/wrapper/Kconfig
```kconfig
# Copyright (c) 2022 Telink Semiconductor
# SPDX-License-Identifier: Apache-2.0

rsource "controller/Kconfig"
rsource "crypto/Kconfig"
```

## hal_v2/wrapper/controller/Kconfig
```kconfig
# Copyright (c) 2022 Telink Semiconductor
# SPDX-License-Identifier: Apache-2.0

config COMPILE_SDK
	bool "Use precompiled BLE SDK library"
	default y
	help
	  Use the precompiled Telink BLE SDK library instead of building from
	  source. When enabled, internal headers like pm_internal.h are not
	  available and must be excluded.

menu "Telink BLE Controller"
	depends on BT_B9X || BT_TLX

choice TL_BLE_CTRL_MAC_TYPE
	prompt "MAC address type"
	default TL_BLE_CTRL_MAC_TYPE_PUBLIC
config TL_BLE_CTRL_MAC_TYPE_PUBLIC
	bool "Public"
config TL_BLE_CTRL_MAC_TYPE_RANDOM_STATIC
	bool "Random static"
endchoice

config TL_BLE_PUBLIC_MAC_ADDR
	depends on TL_BLE_CTRL_MAC_TYPE_PUBLIC
	string "Default Development Public BLE Address"
	default "10:10:10:21:21:21"
	help
	  Development Public BLE Address

config TL_BLE_CTRL_MAC_FLASH
	depends on TL_BLE_CTRL_MAC_TYPE_RANDOM_STATIC
	bool "Store static BLE MAC address in flash"
	default n
	help
	  Store once generated static BLE MAC address in flash

config TL_BLE_CTRL_CONNECTION_INTERVAL_IDX
	int "Connection interval, idx (time = idx * 1.25 ms)"
	default 10
	range 1 255
	help
	  ACL master connection interval index (time = index * 1.25 ms).

config TL_BLE_CTRL_CONNECTION_TIMEOUT_MS
	int "Connection timeout, ms"
	default 4000
	help
	  ACL connection timeout, ms.

if BT_B9X
config TL_BLE_CTRL_RF_POWER
	int "Tx power, dbm"
	default 3
	range -30 9
	help
	  Telink B9X BLE TX power
endif

if SOC_RISCV_TELINK_TL321X
config TL_BLE_CTRL_RF_POWER
	int "Tx power, dbm"
	default 3
	range -20 11
	help
	  Telink TLX BLE TX power
endif

if SOC_RISCV_TELINK_TL721X
config TL_BLE_CTRL_RF_POWER
	int "Tx power, dbm"
	default 3
	range -20 10
	help
	  Telink TLX BLE TX power
endif

if SOC_RISCV_TELINK_TL322X
config TL_BLE_CTRL_RF_POWER
	int "Tx power, dbm"
	default 3
	range -20 10
	help
	  Telink TLX BLE TX power
endif

if SOC_RISCV_TELINK_TL323X
config TL_BLE_CTRL_RF_POWER
	int "Tx power, dbm"
	default 3
	range -20 10
	help
	  Telink TLX BLE TX power
endif

if SOC_RISCV_TELINK_TL521X
config TL_BLE_CTRL_RF_POWER
	int "Tx power, dbm"
	default 3
	range -20 10
	help
	  Telink TLX BLE TX power
endif

config TL_BLE_CTRL_MASTER_MAX_NUM
	int "Maximum number of master connections"
	default 0
	range 0 4
	help
	  Number of master ACL connections supported.

config TL_BLE_CTRL_SLAVE_MAX_NUM
	int "Maximum number of slave connections"
	default 1
	range 0 4
	help
	  Number of slave ACL connections supported.

config TL_BLE_CTRL_EXT_ADV
	bool "Enable extended advertising"
	default y if BT_EXT_ADV
	help
	  Enable extended advertising.

if TL_BLE_CTRL_EXT_ADV

config TL_BLE_CTRL_EXT_ADV_SETS_NUM
	int "Number of supported extended advertising sets"
	default 3
	help
	  Number of supported extended advertising sets.

config TL_BLE_CTRL_EXT_ADV_DATA_LEN_MAX
	int "Maximum extended advertising data length"
	default 320
	help
	  Maximum extended advertising data length.

config TL_BLE_CTRL_EXT_ADV_SCAN_DATA_LEN_MAX
	int "Maximum extended scan response data length"
	default 320
	help
	  Maximum extended scan response data length.

endif # TL_BLE_CTRL_EXT_ADV

config TL_BLE_CTRL_EXT_SCAN
	bool "Enable extended scanning"
	default y if BT_EXT_ADV
	help
	  Enable extended scanning.

config TL_BLE_CTRL_PER_ADV
	bool "Enable periodic advertising"
	default y if BT_PER_ADV
	help
	  Enable periodic advertising.

if TL_BLE_CTRL_PER_ADV

config TL_BLE_CTRL_PER_ADV_SETS_NUM
	int "Number of supported periodic advertising sets"
	default 2
	help
	  Number of supported periodic advertising sets.

config TL_BLE_CTRL_PER_ADV_DATA_LEN_MAX
	int "Maximum periodic advertising data length"
	default 512
	help
	  Maximum periodic advertising data length.

endif # TL_BLE_CTRL_PER_ADV

config TL_BLE_CTRL_PER_ADV_SYNC
	bool "Enable periodic advertising sync"
	default y if BT_PER_ADV_SYNC
	help
	  Enable periodic advertising sync.

config TL_BLE_CTRL_THREAD_STACK_SIZE
	int "Controller thread stack size"
	default 2048
	help
	  Telink BLE Controller thread stack size.

config TL_BLE_CTRL_THREAD_PRIORITY
	int "Controller thread priority"
	default 2
	help
	  Telink BLE Controller thread priority.

config TL_BLE_CTRL_THREAD_PERIOD_MS
	int "Controller thread period, ms"
	default 10
	help
	  Telink BLE Controller thread period in ms.

config BT_TLX_CHANNEL_SOUNDING
	bool "Telink TLX Channel Sounding support"
	depends on BT_TLX
	depends on SOC_RISCV_TELINK_TL322X || SOC_RISCV_TELINK_TL721X
	help
	  Enable Channel Sounding (Bluetooth 6.0) in the Telink TLX Controller.
	  NOTE: Requires Telink proprietary algorithm library (.a) compiled
	  for Andes toolchain, not compatible with GNU RISC-V toolchain.

endmenu
```

## hal_v2/wrapper/crypto/Kconfig
```kconfig
# Copyright (c) 2026 Telink Semiconductor
# SPDX-License-Identifier: Apache-2.0

if TELINK_B9X_MBEDTLS_HW_ACCELERATION || TELINK_B9X_TINYCRYPT_HW_ACCELERATION || \
	TELINK_TLX_MBEDTLS_HW_ACCELERATION || TELINK_TLX_TINYCRYPT_HW_ACCELERATION

choice
	prompt "Telink crypto back-ends log level"
	default TL_TELINK_CRYPTO_BACKEND_LOG_LEVEL_INFO
	help
		This option selects log level for Telink crypto back-ends
config TL_TELINK_CRYPTO_BACKEND_LOG_LEVEL_CRIT
	bool "Critical"
config TL_TELINK_CRYPTO_BACKEND_LOG_LEVEL_WARN
	bool "Warning"
config TL_TELINK_CRYPTO_BACKEND_LOG_LEVEL_INFO
	bool "Informational"
config TL_TELINK_CRYPTO_BACKEND_LOG_LEVEL_DEBG
	bool "Debug"
endchoice

config TL_TELINK_CRYPTO_BACKEND_LOG_LEVEL
	int
	default 1 if TL_TELINK_CRYPTO_BACKEND_LOG_LEVEL_CRIT
	default 2 if TL_TELINK_CRYPTO_BACKEND_LOG_LEVEL_WARN
	default 3 if TL_TELINK_CRYPTO_BACKEND_LOG_LEVEL_INFO
	default 4 if TL_TELINK_CRYPTO_BACKEND_LOG_LEVEL_DEBG
	default 0

if TELINK_TLX_MBEDTLS_HW_ACCELERATION || TELINK_TLX_TINYCRYPT_HW_ACCELERATION

config TL_TELINK_TLX_SHA_HW_SLOTS
	int "Telink TLX simultimes HW SHA slots number"
	range 0 64
	default 2 if BOARD_TL3218X_RETENTION
	default 4 if BOARD_TL3218X
	default 8

endif

endif
```

## tl_ble_src/Kconfig
```kconfig
# Copyright (c) 2022 Telink Semiconductor
# SPDX-License-Identifier: Apache-2.0

rsource "vendor/controller/Kconfig"
```
